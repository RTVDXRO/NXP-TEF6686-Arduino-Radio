/*
  TEF6686HN/V102 AM FM for XDR-GTK
  by RTVDXRO
  
  - Xmas Light Edition -
 
 ( for old "historical" versions visit rdi.boards.net ! )

    * by default audio output level is fixed -> 0dB or +2dB
    

    * On genuine XDR-GTK interface de-emphasis switch is acting now this way:

  50uS => NORMAL;

  75uS => FLAT ( 0uS );

  0uS  => MPX out mode ( DAC_Left : FM MPX (DARC) signal / DAC_Right : mono audio );


    * XDR-GTK Antenna Switch option:

  Ant A = Normal

  Ant B = iMS enabled ( FM multipath suppression when the receiver is in a moving vehicle )

  Ant C = EQ enabled ( FM channel equalizer for improved field performance )

  Ant D = Both enabled

  In some altered versions of XDR-GTK the word "Ant" has been replaced with others such as the funny "DX", which, apart from the word itself on a button,
  doesn't bring a plus of performance on weak fringe RF signals, being in fact only just to impress the ignorants :)

  Great special thanks to Konrad Kosmatka, author of the original & brilliant version for Sony XDR-F1HD
  https://fmdx.pl/xdr-i2c/
  https://fmdx.pl/xdr-gtk/

  Special thanks to NXP BU Automotive Car Entertainment Team
  and also to ( in alphabetical order ):
  - ace919
  - Brian Beezley
  - dxhdtv
  - eggplant886
  - fmdxbp
  - Jan Kolar
  - Marcin Woloszczuk
  - Mihai Popa          https://github.com/stailus/tef6686_rds
  - makserge            https://github.com/makserge/tef6686_radio
  - Nicu Florica        http://nicuflorica.blogspot.com/2020/02/radio-cu-tef6686.html
  - ODJeetje
  - Olivier Guillaume
  - Przemyslaw Korpas
  - VoXiTPro            https://github.com/voxit1512/Tef6686

  and many other enthusiasts ...

  Tested on Arduino Nano V3.0 at 5V

  Feel free to add your own contribution to this nice project !
*/
#include <Wire.h>

#define SERIAL_PORT_SPEED 115200
#define SERIAL_BUFFER_SIZE 16
char buff[SERIAL_BUFFER_SIZE];
uint8_t buff_pos = 0;
uint32_t REG_FREQ;
uint32_t MODA_FREQ = 0;
uint32_t MODF_FREQ = 0;
uint32_t timer = 0;          // Signal level reporting timer
uint32_t timer_DATA = 0;     // DATA reporting timer
int8_t current_filter = -1;  // Current FIR filter (-1 is adaptive)
int8_t current_set = -1;     // Current FIR filter (-1 is adaptive)
int8_t set_filter = 10;
int8_t forced_mono;
int16_t LevelOffset;
int16_t Level;
int8_t mode;
int8_t AGC_tress;
int8_t RF1plus;
int8_t RF2plus;
int8_t Squelch;
int8_t Setsquelch;
int16_t nDeemphasis, volume;
uint32_t freq;
int8_t Filter_AM = 127;
int8_t Filter_FM = 127;

/* Scan */
uint16_t scan_start = 0;
uint16_t scan_end = 0;
uint16_t scan_step = 0;
uint8_t scan_filter = 0;
uint16_t AM_start_scan = 0;
uint16_t AM_scan_end = 0;
uint16_t AM_scan_step = 0;
uint8_t AM_scan_filter = 0;

#define TIMER_INTERVAL 240
#define DATA_TIMER_INTERVAL 24
#define AM_VOL_SCALE -1
byte DSP_I2C = 0x64;

int8_t radio_mode;
int8_t scan_mode;

static const uint8_t DSP_INIT[] PROGMEM =
{
  0x05, 0x1E, 0x5A, 0x01, 0x5A, 0x5A,     // Reset the device
  0x01, 100,                              // Wait 100ms
  0x03, 0x1c, 0x00, 0x00,                 // Clear
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  0x09, 0x40, 0x04, 0x01, 0x00, 0x8C, 0xA0, 0x00, 0x00, 0x00,       // 9216 MHz crystal reference
  // 0x09, 0x40, 0x04, 0x01, 0x00, 0x3D, 0x09, 0x00, 0x00, 0x00,       // 4000 MHz crystal reference
  0x05, 0x40, 0x05, 0x01, 0x00, 0x01,                               // Command APPL_Activate brings the device into ‘active state’ = radio standby
  0x02, 0xFF, 100,                                                  // Wait 100 ms

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  0x09, 0x20, 0x18, 0x01, 0x00, 0xD2, 0x00, 0xD2, 0x00, 0xFA,                                                  // FM Set_NoiseBlanker_Option    (1, 210, 210, 250) 
  // 0x05, 0x20, 0x1F, 0x01, 0x01, 0xF4,                                                                          // FM Set_Deemphasis             (1, 500)
  0x11, 0x20, 0x26, 0x01, 0xFF, 0xEC, 0xFF, 0xE2, 0xFF, 0xD8, 0xFF, 0xCE, 0xFF, 0xC4, 0xFF, 0xC4, 0xFF, 0xC4,  // FM Set_LevelStep              (1, -20, -30, -40, -50, -60, -60, -60)  
  0x05, 0x20, 0x27, 0x01, 0x00, 0x00,                                                                          // FM Set_LevelOffset            (1, 0)
  
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  0x07, 0x21, 0x3A, 0x01, 0x00, 0x01, 0x00, 0x1E,                                                              // AM_Set_Lowcut_Min             (1, 1, 30)
 
  0x00
};

// XDR-GTK Antenna Switch option ( Ant n or S n or DX n ... etc )
static const uint8_t INIT_1[] PROGMEM =                                                                      // Ant A
{
  // Multipath Off & ChannelEqualizer Off
  0x05, 0x20, 0x14, 0x01, 0x00, 0x00,                                                                          // FM_Set_MphSuppression(1,0)
  0x05, 0x20, 0x16, 0x01, 0x00, 0x00,                                                                          // FM_Set_ChannelEqualizer(1,0)
  0x00
};

static const uint8_t INIT_2[] PROGMEM =                                                                      // Ant B
{
  // Multipath On & ChannelEqualizer Off
  0x05, 0x20, 0x14, 0x01, 0x00, 0x01,                                                                          // FM_Set_MphSuppression(1,1)
  0x05, 0x20, 0x16, 0x01, 0x00, 0x00,                                                                          // FM_Set_ChannelEqualizer(1,0)
  0x00
};

static const uint8_t INIT_3[] PROGMEM =                                                                      // Ant C
{
  // Multipath Off & ChannelEqualizer On
  0x05, 0x20, 0x14, 0x01, 0x00, 0x00,                                                                          // FM_Set_MphSuppression(1,0)
  0x05, 0x20, 0x16, 0x01, 0x00, 0x01,                                                                          // FM_Set_ChannelEqualizer(1,1)
  0x00
};

static const uint8_t INIT_4[] PROGMEM =                                                                      // Ant D
{
  // Multipath On & ChannelEqualizer On
  0x05, 0x20, 0x14, 0x01, 0x00, 0x01,                                                                          // FM_Set_MphSuppression(1,1)
  0x05, 0x20, 0x16, 0x01, 0x00, 0x01,                                                                          // FM_Set_ChannelEqualizer(1,1)
  0x00
};

void Write(uint8_t *buf, uint8_t len)
{
  Wire.beginTransmission(DSP_I2C);
  for (int i = 0; i < len; i++)
    Wire.write(*buf++);
  Wire.endTransmission();
}

void Read(uint8_t *buf, uint8_t len)
{
  uint8_t lenrec = Wire.requestFrom(DSP_I2C, len);
  for (int i = 0; i < lenrec; i++)
    *buf++ = Wire.read();
}

void Set_Cmd(uint8_t mdl, uint8_t cmd, int len, ...)
{
  uint8_t buf[31];
  uint16_t temp;
  va_list vArgs;
  va_start(vArgs, len);
  buf[0] = mdl;
  buf[1] = cmd;
  buf[2] = 1;
  for (uint8_t i = 0; i < len; i++)
  {
    temp = va_arg(vArgs, uint16_t);
    buf[3 + i * 2] = (uint8_t)(temp >> 8);
    buf[4 + i * 2] = (uint8_t)temp;
  }
  va_end(vArgs);
  Write(buf, len * 2 + 3);
}

void Get_Cmd(uint8_t mdl, uint8_t cmd, int16_t *receive, int len)
{
  uint8_t buf[3];
  buf[0] = mdl;
  buf[1] = cmd;
  buf[2] = 1;
  Write(buf, 3);
  Read((uint8_t*)receive, 2 * len);
  for (uint8_t i = 0; i < len; i++)
  {
    uint16_t newval = (uint8_t)(receive[i] >> 8) | (((uint8_t)(receive[i])) << 8);
    receive[i] = newval;
  }
}

void dsp_write_data(const uint8_t* data)
{
  uint8_t *pa = (uint8_t *)data;
  uint8_t len, i, first;
  for (;;)
  {
    len = pgm_read_byte_near(pa++);
    first = pgm_read_byte_near(pa);
    if (!len)
      break;
    if (len == 2 && first == 0xff)
    {
      int delaytime = pgm_read_byte_near(++pa);
      delay(delaytime);
      pa++;
    }
    else
    {
      Wire.beginTransmission(DSP_I2C);
      for (int i = 0; i < len; i++)
        Wire.write(pgm_read_byte_near(pa++));
      Wire.endTransmission();
    }
  }
}

void scan(bool continous)
{

  uint32_t freq;
  uint32_t buffer;

  if ( scan_start < 6500 )
  {
    scan_mode = 1;
    scan_start = AM_start_scan;
    scan_end = AM_scan_end;
    scan_step = AM_scan_step;
  }
  else
  {
    scan_mode = 0;
  }

  if (scan_mode == 0)
  {
    if (scan_filter == -1) {
      set_filter = 10;
    } else {
      set_filter = scan_filter;
    }
    Set_Cmd(32, 1, 2, 1, scan_start);
  }
  else
  {
    Set_Cmd(33, 1, 2, 1, scan_start);
  }
  do
  {
    Serial.print('U');
    for (freq = scan_start; freq <= scan_end; freq += scan_step)
    {
      Set_Cmd( scan_mode == 0 ? 32 : 33, 1, 2, 1, freq);
      Serial.print(scan_mode == 0 ? freq * 10 : freq, DEC);
      Serial.print('=');
      delay(10);

      int16_t uQuality[4] = { 0 };
      Get_Cmd(scan_mode == 0 ? 32 : 33, 128, uQuality, 4);
      Serial.print(uQuality[1] / 10, DEC);
      Serial.print(',');
    }

    Serial.print('\n');
  } while (continous && !Serial.available());
  if (radio_mode == 0)
  {
    if (current_filter == -1) {
      set_filter = 10;
    } else {
      set_filter = current_filter;
    }
    Set_Cmd( 32, 1, 2, 1, REG_FREQ / 10 );
  }
  else
  {
    Set_Cmd( 33, 1, 2, 1, REG_FREQ );
  }
}

void get_DATA()
{
  int16_t uDATA_Data[8] = {0};
  Get_Cmd(32, 131, uDATA_Data, 8);
  if ( bitRead(uDATA_Data[0], 15) == 1 )
  {
    Serial.print('P');
    serial_hex(uDATA_Data[1] >> 8);
    serial_hex(uDATA_Data[1]);
    Serial.print('\n');
    Serial.print('R');
    serial_hex(uDATA_Data[2] >> 8);
    serial_hex(uDATA_Data[2]);
    serial_hex(uDATA_Data[3] >> 8);
    serial_hex(uDATA_Data[3]);
    serial_hex(uDATA_Data[4] >> 8);
    serial_hex(uDATA_Data[4]);
    serial_hex(uDATA_Data[5] >> 8);
    Serial.print('\n');
  }
}

void serial_hex(uint8_t val)
{
  Serial.print((val >> 4) & 0xF, HEX);
  Serial.print(val & 0xF, HEX);
}

void Set_AGC_tresshold(uint8_t val)
{
  if (val == 0) {
    Set_Cmd(32, 11, 1, 920, 0);
    Set_Cmd(33, 11, 1, 1020);
  } else if (val == 1) {
    Set_Cmd(32, 11, 1, 900, 0);
    Set_Cmd(33, 11, 1, 1000);
  } else if (val == 2) {
    Set_Cmd(32, 11, 1, 880, 0);
    Set_Cmd(33, 11, 1, 980);
  } else {
    Set_Cmd(32, 11, 1, 860, 0);
    Set_Cmd(33, 11, 1, 960);
  }
}

void Set_RF_Gain(uint8_t val, uint8_t val1)
{
  if (val == 1 && val1 == 0) {
    Set_Cmd(32, 39, 1, 60);
    Set_Cmd(33, 39, 1, 30);
  } else if (val == 0 && val1 == 1) {
    Set_Cmd(32, 39, 1, 120);
    Set_Cmd(33, 39, 1, 60);
  } else if (val == 1 && val1 == 1) {
    Set_Cmd(32, 39, 1, 180);
    Set_Cmd(33, 39, 1, 120);
  } else {
    Set_Cmd(32, 39, 1, 0);
    Set_Cmd(33, 39, 1, 0);
  }
}

void Set_Deempasis(uint8_t val)
{
  if (val == 0) {
    Set_Cmd(32, 31, 1, 500); // 50uS
    Set_Cmd(32, 85, 1, 0);
  } else  if (val == 1) {
    Set_Cmd(32, 31, 1, 0);   // 0 uS
    Set_Cmd(32, 85, 1, 0);
  } else if (val == 2) {
    Set_Cmd(32, 31, 1, 0);
    Set_Cmd(32, 85, 1, 1);   // MPX
  }
}

void setup()
{
  Wire.begin();
  Serial.begin(115200);
  delay(40);
  int16_t uState;
  Get_Cmd(64, 128, &uState, 1);
  if (uState < 2)
    dsp_write_data(DSP_INIT);
  else if (uState > 2)
  {
    Set_Cmd(64, 1, 1, 1);
  }

  while (true)
  {
    if (Serial.available() > 0)
    {
      if (Serial.read() == 'x')
      {
        while (!Serial.available());
        if (Serial.read() == '\n')
          break;
      }
    }
  }
  delay(20);
  while (Serial.available() > 0)
    Serial.read();  // clear the serial buffer
  Serial.print("\nOK\n");
  if (AM_VOL_SCALE != -1) {
    int SetVolScale = map(AM_VOL_SCALE, 0, 100, -120, 60);
    Set_Cmd(33, 80, 1, SetVolScale);
  }
}

void loop()
{
  // check signal level and 19kHz subcarrier every TIMER_INTERVAL
  if ((millis() - timer) >= TIMER_INTERVAL)
  {
if (radio_mode == 0) {
      Serial.print('S');
      uint16_t uStatus;
      Get_Cmd(32, 133, &uStatus, 1);
      char stereo ;
      if (!forced_mono)
        stereo = (uStatus & (1 << 15)) ? 's' : 'm';
      else
        stereo = (uStatus & (1 << 15)) ? 'S' : 'M';
      Serial.print(stereo);
      }
    
    int16_t uQuality[4] = { 0 };
    if (radio_mode == 0) {
      Get_Cmd(32, 128, uQuality, 6);
    }
    else {
      Get_Cmd(33, 128, uQuality, 4);
    }
    if (uQuality[1] > 1200) {
      uQuality[1] = 1200;
    }
    Serial.print(uQuality[1] / 10, DEC);
    Serial.print(',');
    if ((uQuality[2] > 1000) && (radio_mode == 0)) {
      uQuality[2] = 1000; // Shoots sometimes above 1000 but max is 1000 in datasheet,
    }
    if (radio_mode == 1) {
      uQuality[2] = uQuality[2] / 5; // for AM max 500% reset to 100%
    }
    Serial.print(uQuality[2] / 10, DEC);
    Serial.print(',');
    Serial.print(uQuality[3] / 10, DEC);
    Serial.print('\n');
    timer = millis();
  }

  if (radio_mode == 0) {
    if ((millis() - timer_DATA) >= DATA_TIMER_INTERVAL)
    {
      get_DATA();
      timer_DATA = millis();
    }
  }

  if (Serial.available() > 0)
  {
    buff[buff_pos] = Serial.read();
    if (buff[buff_pos] != '\n' && buff_pos != SERIAL_BUFFER_SIZE - 1)
      buff_pos++;
    else {
      buff[buff_pos] = 0x00;
      buff_pos = 0;

      switch (buff[0])
      {

        case 'x':
          Serial.println("OK");
          break;

        case 'Y':  // Audio volume scaler
          volume = atoi(buff + 1);
          if (volume == 0) {
            Set_Cmd(48, 10, 1, 0);       // 0 dB
            Set_Cmd(48, 11, 1, 0);       // unmute
          } else {
            Set_Cmd(48, 10, 1, 20);     // +2 dB
            // Set_Cmd(48, 10, 1, volume *6 - 570);  // variable volume control
            Set_Cmd(48, 11, 1, 0);      // unmute
          }
          Serial.print("Y");
          Serial.println(volume);
          break;

        case 'S':
          if (buff[1] == 'a')
          {
            scan_start = (atol(buff + 2) + 5) / 10;
            AM_start_scan = atol(buff + 2);
          }
          else if (buff[1] == 'b')
          {
            scan_end = (atol(buff + 2) + 5) / 10;
            AM_scan_end = atol(buff + 2);
          }
          else if (buff[1] == 'c')
          {
            scan_step = (atol(buff + 2) + 5) / 10;
            AM_scan_step = atol(buff + 2);
          }
          else if (buff[1] == 'f')
          {
            scan_filter = atol(buff + 2);
          }
          else if (scan_start > 0 && scan_end > 0 && scan_step > 0 && scan_filter >= 0)
          {
            if (buff[1] == 'm')
              scan(true);   // Multiple (continous) scan
            else
              scan(false);  // Single scan
          }
          break;

        case 'B':
          forced_mono = atol(buff + 1);
          if (forced_mono == 1)
            Set_Cmd(32, 66, 1, 2, forced_mono == 1 ? 2 : 0 , 60);
          else
            Set_Cmd(32, 66, 1, 0, forced_mono == 1 ? 2 : 0 , 200);
          Serial.print('B');
          Serial.print(forced_mono ? '1' : '0');
          Serial.print('\n');
          break;
          
        case 'M':
          mode = atol(buff + 1);
          if (mode == 0) {
            if (MODF_FREQ == 0) {
              MODF_FREQ = 87500;
            }
            Set_Cmd(32, 1, 2, 1, MODF_FREQ / 10);
            Serial.println("M0");
            Serial.print('T');
            Serial.println(MODF_FREQ);
            if (Filter_AM != 127) {
              Filter_AM = current_filter;
            }
            if (Filter_FM == 127) {
              Filter_FM = -1;
            }
            current_filter = Filter_FM;
            radio_mode = 0;
          } else {
            if (MODA_FREQ == 0) {
              MODA_FREQ = 522;
            }
            Set_Cmd(33, 1, 2, 1, MODA_FREQ);
            Serial.println("M1");
            Serial.print('T');
            Serial.println(MODA_FREQ);
            Filter_FM = current_filter;
            if (Filter_FM != 127) {
              Filter_FM = current_filter;
            }
            if (Filter_AM == 127) {
              Filter_AM = 21;
            }
            current_filter = Filter_AM;
            radio_mode = 1;
          }
          Serial.print('F');
          Serial.println(current_filter);
          Serial.print('V');
          Serial.println(LevelOffset);
          break;

        case 'T':  // Tune to a frequency (to do keep filter settings)
          freq = atol(buff + 1);
          REG_FREQ = freq;
          if ((REG_FREQ >= 65000) && (REG_FREQ <= 108000)) {
            Set_Cmd(32, 1, 2, 1, REG_FREQ / 10);
            Serial.println("M0");
            Serial.print('T');
            Serial.println(REG_FREQ);
            if (radio_mode == 1) {                         // from AM to FM then switch to adaptive filter AUTO in xdr-gtk
              if (Filter_AM != 127) {
                Filter_AM = current_filter;
              }
              if (Filter_FM == 127) {
                Filter_FM = -1;
              }
              current_filter = Filter_FM;
            }
            radio_mode = 0;
            MODF_FREQ = REG_FREQ;
          } else if ((REG_FREQ >= 144) && (REG_FREQ <= 26999)) {
            Set_Cmd(33, 1, 2, 1, REG_FREQ);
            Serial.println("M1");
            Serial.print('T');
            Serial.println(REG_FREQ);
            if (radio_mode == 0) {                       // from FM to AM then use filter 21 3,9khz 4khz
              if (Filter_FM != 127) {
                Filter_FM = current_filter;
              }
              if (Filter_AM == 127) {
                Filter_AM = 21;
              }
              current_filter = Filter_AM;
            }
            radio_mode = 1;
            MODA_FREQ = REG_FREQ;
          }
          Serial.print('F');
          Serial.println(current_filter);
          Serial.print('V');
          Serial.println(LevelOffset);
          break;

        case 'F':  // Change FIR filters
          current_filter = atoi(buff + 1);
          if (radio_mode == 0) {
            if (current_filter == -1) {
              set_filter = 10;
            } else {
              set_filter = current_filter;
            }
          }
          else {
          }
          Serial.print('F');
          Serial.println(buff + 1);
          break;

        case 'V':      // Set AM lna (in XDR-GTK enable Show antenna input alignment) (NO FM)
          LevelOffset = atoi(buff + 1);
          Level = map(LevelOffset, 0, 127, 0, 360);
          if (radio_mode == 1) {
            Set_Cmd(33, 12, 1, Level);
          }
          Serial.print('V');
          Serial.println(buff + 1);
          break;

        case 'Q':  // Audio volume scaler
          Squelch = atoi(buff + 1);
          if (Squelch != -1 && AM_VOL_SCALE == -1) {
            int Setsquelch = map(Squelch, 0, 100, -120, 60);
            Set_Cmd(33, 80, 1, Setsquelch);
            Serial.print("Q");
            Serial.println(Squelch);
          }
          break;

        case 'D':  // Change the de-emphasis
          nDeemphasis = atoi(buff + 1);
          Serial.print("D");
          Set_Deempasis(nDeemphasis);
          Serial.println(nDeemphasis);
          break;

        case 'G':
          Serial.print('G');
          RF1plus = buff[1] - 48;
          RF2plus = buff[2] - 48;
          Set_RF_Gain(RF1plus, RF2plus);
          Serial.print(RF1plus);
          Serial.println(RF2plus);
          break;

        case 'A':  // AGC  (check what levelstepping does)
          Serial.print('A');
          AGC_tress = atoi(buff + 1);
          Set_AGC_tresshold(AGC_tress);
          Serial.println(AGC_tress);
          break;
        /*
          case 'C':  // Xtreme DX threshold extender ( increased sensitivity with lower demodulation threshold - optional additional external circuit required )
          Lorem ipsum - see rdi.boards.net for more ...
        */
        case 'Z':
          Serial.print('Z');
          if (buff[1] == '0') {
            dsp_write_data(INIT_1);
            Serial.print("0");
          } else if (buff[1] == '1') {
            dsp_write_data(INIT_2);
            Serial.print("1");
          } else if (buff[1] == '2') {
            dsp_write_data(INIT_3);
            Serial.print("2");
          } else if (buff[1] == '3') {
            dsp_write_data(INIT_4);
            Serial.print("3");
          } else {
            Serial.print("4");
          }
          Serial.print('\n');

          Set_AGC_tresshold(AGC_tress);
          Set_RF_Gain(RF1plus, RF2plus);
          Set_Deempasis(nDeemphasis);
          break;

        case 'X':  // shutdown
          Set_Cmd(64, 1, 1, 1);
          TWCR = 0;  // Release SDA and SCL lines used by hardware I2C
          Serial.println("X");
          delay(10);
          asm("jmp 0");
          break;
      }
    }
  }
}
/*  Happy DXing !  */
